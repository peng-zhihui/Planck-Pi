## linux-5.4.77/drivers/staging/media/sunxi/cedar/Kconfig
```kconfig
# SPDX-License-Identifier: GPL-2.0
source "drivers/staging/media/sunxi/cedar/ve/Kconfig"
source "drivers/staging/media/sunxi/cedar/ion/Kconfig"
```

## linux-5.4.77/virt/drivers/staging/media/sunxi/cedar/ion/Kconfig
```kconfig
config VIDEO_SUNXI_CEDAR_ION
	tristate "Allwinner CedarX Ion Driver"
	depends on ARCH_SUNXI && OF_ADDRESS && HAS_DMA && MMU
	select GENERIC_ALLOCATOR
	select DMA_SHARED_BUFFER
	select CMA
	select DMA_CMA
	help
	  Allwinner libcdc compatible Ion driver.
```

## linux-5.4.77/virt/drivers/staging/media/sunxi/cedar/ve/Kconfig
```kconfig
config VIDEO_SUNXI_CEDAR_VE
	tristate "Allwinner CedarX VideoEngine Driver"
    select DMA_SHARED_BUFFER
	---help---
	  This is the driver for sunxi video decoder, including h264/
	  mpeg4/mpeg2/vc1/rmvb.
	  To compile this driver as a module, choose M here: the
	  module will be called cedar_dev.
```

## uboot/configs/planck_pi_defconfig
```kconfig
CONFIG_ARM=y
CONFIG_ARCH_SUNXI=y
CONFIG_MACH_SUNIV=y
CONFIG_DEFAULT_DEVICE_TREE="suniv-f1c100s-generic"

CONFIG_SYS_CLK_FREQ=600000000
CONFIG_DRAM_CLK=168
CONFIG_DRAM_ZQ=0

CONFIG_CONS_INDEX=2

CONFIG_SPL=y
CONFIG_SPL_SPI_SUNXI=y
CONFIG_MMC_SUNXI_SLOT_EXTRA=1

CONFIG_SYS_TEXT_BASE=0x81700000

CONFIG_ENV_IS_NOWHERE=y
CONFIG_ENV_IS_IN_FAT=n
CONFIG_USE_DEFAULT_ENV_FILE=y
CONFIG_DEFAULT_ENV_FILE="configs/uboot.env"

CONFIG_BOOTDELAY=2

CONFIG_NET=n

CONFIG_SPI=y
CONFIG_DM_SPI=y
CONFIG_SPI_SUNXI=y

CONFIG_MTD=y
CONFIG_DM_MTD=y
CONFIG_CMD_MTD=y
CONFIG_MTD_SPI_NAND=y

CONFIG_SPI_FLASH=y
CONFIG_DM_SPI_FLASH=y
CONFIG_SPI_FLASH_BAR=y
CONFIG_SPI_FLASH_WINBOND=y

CONFIG_PHY=y
CONFIG_PHY_SUN4I_USB=y

CONFIG_USB_MUSB_SUNXI=y
CONFIG_USB_MUSB_GADGET=y
CONFIG_USB_MUSB_PIO_ONLY=y
CONFIG_USB_MUSB_DISABLE_BULK_COMBINE_SPLIT=y
CONFIG_USB_GADGET_VBUS_DRAW=250

CONFIG_USB_STORAGE=y
CONFIG_CMD_USB_MASS_STORAGE=y

CONFIG_CMD_FASTBOOT=n
CONFIG_FASTBOOT=n
CONFIG_USB_FUNCTION_FASTBOOT=n

CONFIG_CMD_MTDPARTS=y

CONFIG_USB_GADGET_DOWNLOAD=y

CONFIG_CMD_DFU=y
CONFIG_DFU=y
CONFIG_DFU_OVER_USB=y
CONFIG_DFU_TIMEOUT=y
CONFIG_DFU_MMC=y
CONFIG_DFU_SF=y
CONFIG_DFU_MTD=y
```
